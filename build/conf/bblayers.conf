## build/conf/bblayers.conf
```bitbake
# POKY_BBLAYERS_CONF_VERSION is increased each time build/conf/bblayers.conf
# changes incompatibly
POKY_BBLAYERS_CONF_VERSION = "2"

BBPATH = "${TOPDIR}"
BBFILES ?= ""

BBLAYERS ?= " \
  /home/hieupm/Project/poky/meta \
  /home/hieupm/Project/poky/meta-poky \
  /home/hieupm/Project/poky/meta-yocto-bsp \
  /home/hieupm/Project/poky/meta-sunxi \
  /home/hieupm/Project/poky/meta-arm/meta-arm \
  /home/hieupm/Project/poky/meta-arm/meta-arm-toolchain \
  /home/hieupm/Project/poky/meta-openembedded/meta-python \
  /home/hieupm/Project/poky/meta-openembedded/meta-oe \
  "
```
